## board/qnap/ts212/Kconfig
```kconfig
if TARGET_QNAP_TS212

config SYS_BOARD
	default "ts212"

config SYS_VENDOR
	default "qnap"

config SYS_CONFIG_NAME
	default "qnap_ts212"

endif
```

## configs/qnap-ts212-kw6281_defconfig
```kconfig
CONFIG_ARM=y
CONFIG_KIRKWOOD=y
CONFIG_ARCH_CPU_INIT=y
CONFIG_ARCH_KIRKWOOD=y
CONFIG_SKIP_LOWLEVEL_INIT=y
CONFIG_LTO=y
CONFIG_SYS_THUMB_BUILD=y
CONFIG_TARGET_QNAP_TS212=y
CONFIG_SYS_DCACHE_OFF=y
CONFIG_SYS_KWD_CONFIG="board/qnap/ts212/kwbimage.cfg"
CONFIG_SYS_LOAD_ADDR=0x800000
CONFIG_SYS_PROMPT="TS212> "
CONFIG_TEXT_BASE=0x600000
CONFIG_NR_DRAM_BANKS=1
CONFIG_IDENT_STRING="\nQNAP-TS212"
CONFIG_HAS_BOARD_SIZE_LIMIT=y
CONFIG_BOARD_SIZE_LIMIT=524288
CONFIG_HUSH_PARSER=y

#Device tree support
CONFIG_CMD_FDT=y
CONFIG_OF_CONTROL=y
CONFIG_DEFAULT_DEVICE_TREE="marvell/kirkwood-ts219-6281"

#SPI Flash support
CONFIG_SYS_NO_FLASH=y
CONFIG_KIRKWOOD_SPI=y
CONFIG_SPI=y
CONFIG_DM_SPI=y
CONFIG_SPI_FLASH=y
CONFIG_DM_SPI_FLASH=y
CONFIG_SPI_FLASH_STMICRO=y
CONFIG_CMD_SF=y
CONFIG_MTD=y
CONFIG_DM_MTD=y
CONFIG_CMD_MTDPARTS=y
CONFIG_SPI_FLASH_MTD=y
CONFIG_MTDIDS_DEFAULT="nor0=spi_flash.0"
CONFIG_MTDPARTS_DEFAULT="mtdparts=spi_flash.0:512K@0(uboot)ro,256K@512K(uboot_env),256K@768K(nas_config)ro,4M@1M(kernel),11M@5M(init_rd)"
CONFIG_FDT_FIXUP_PARTITIONS=y

#Env support
CONFIG_ENV_IS_IN_SPI_FLASH=y
#full sector size
#CONFIG_ENV_SIZE=0x40000
#note : full sector =0x40000, but not needed
#	and 0x1000 is compatible with legacy partition
CONFIG_ENV_SIZE=0x1000
CONFIG_ENV_OFFSET=0x80000
CONFIG_ENV_SECT_SIZE_AUTO=y
CONFIG_ENV_SECT_SIZE=0x20000

#SATA support
CONFIG_CMD_SATA=y
CONFIG_SATA=y
CONFIG_SATA_MV=y
CONFIG_SYS_SATA_MAX_DEVICE=2

#partitions and filesystems
CONFIG_DOS_PARTITION=y
CONFIG_PARTITION_TYPE_GUID=y
CONFIG_EFI_PARTITION=y
CONFIG_ISO_PARTITION=y
CONFIG_LBA48=y
CONFIG_SYS_64BIT_LBA=y
CONFIG_CMD_FS_GENERIC=y
CONFIG_FS_EXT2=y
CONFIG_FS_EXT4=y
CONFIG_FS_FAT=y

#ethernet support
CONFIG_MVGBE=y
CONFIG_MII=y
CONFIG_NET_RANDOM_ETHADDR=y
CONFIG_NETCONSOLE=y
CONFIG_PHY_MARVELL=y
CONFIG_CMD_DHCP=y
CONFIG_CMD_MII=y
CONFIG_CMD_PING=y

#usb support
CONFIG_CMD_USB=y
CONFIG_USB=y
CONFIG_USB_EHCI_HCD=y
CONFIG_USB_STORAGE=y

#Boot configuration
CONFIG_BOOTDELAY=0
CONFIG_BOOTSTD=y
CONFIG_BOOTSTD_FULL=y
CONFIG_BOOTMETH_EXTLINUX=y
```
